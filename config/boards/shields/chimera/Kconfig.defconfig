## config/boards/shields/chimera/Kconfig.defconfig
```kconfig
if SHIELD_CHIMERA_LEFT

config ZMK_KEYBOARD_NAME
    default "Chimera"

config ZMK_SPLIT_ROLE_CENTRAL
    default y

endif

if SHIELD_CHIMERA_LEFT || SHIELD_CHIMERA_RIGHT

config ZMK_SPLIT
    default y

endif
```

## config/boards/shields/chimera/Kconfig.shield
```kconfig
config SHIELD_CHIMERA_LEFT
    def_bool $(shields_list_contains,chimera_left)

config SHIELD_CHIMERA_RIGHT
    def_bool $(shields_list_contains,chimera_right)
```
