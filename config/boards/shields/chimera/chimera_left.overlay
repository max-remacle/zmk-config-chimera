#include "chimera.dtsi"

&kscan0 {

        compatible = "zmk,kscan-gpio-matrix";
        wakeup-source;

        diode-direction = "col2row";
    row-gpios
        = <&gpio0 6 (GPIO_ACTIVE_LOW | GPIO_PULL_UP)>
        , <&gpio0 8 (GPIO_ACTIVE_LOW | GPIO_PULL_UP)>
        , <&gpio0 17 (GPIO_ACTIVE_LOW | GPIO_PULL_UP)>
        , <&gpio0 20 (GPIO_ACTIVE_LOW | GPIO_PULL_UP)>
        ;
    
    col-gpios
        = <&gpio1 11 (GPIO_ACTIVE_LOW | GPIO_PULL_UP)>
        , <&gpio1 13 (GPIO_ACTIVE_LOW | GPIO_PULL_UP)>
        , <&gpio1 15 (GPIO_ACTIVE_LOW | GPIO_PULL_UP)>
        , <&gpio0 2 (GPIO_ACTIVE_LOW | GPIO_PULL_UP)>
        , <&gpio0 29 (GPIO_ACTIVE_LOW | GPIO_PULL_UP)>
        , <&gpio0 31 (GPIO_ACTIVE_LOW | GPIO_PULL_UP)>
        ;
};